#include <stdint.h>
#include "tm4c123gh6pm.h"
#include "ST7735.h"
#include "Random.h"
#include "TExaS.h"
#include "ADC.h"
#include "Sound.h"
#include "Timer0.h"
#include "Random.h"

//repace bg with correct sky and floor

const unsigned short entei[] = {
 0xEEF8, 0xEEF8, 0xEEF8, 0xEEF8, 0xEEF8, 0xEEF8, 0xEEF8, 0xEEF8, 0xEEF8, 0xEEF8, 0xEEF8, 0xEEF8, 0xEEF8, 0xEEF8, 0xEEF8, 0xEEF8,
 0xEEF8, 0xEEF8, 0xEEF8, 0x0000, 0x0000, 0xEEF8, 0xEEF8, 0xEEF8, 0xEEF8, 0xEEF8, 0xEEF8, 0x0000, 0x0000, 0xEEF8, 0xEEF8, 0xEEF8,
 0xEEF8, 0xEEF8, 0x0000, 0xB551, 0xB551, 0x0000, 0xEEF8, 0x0000, 0x0000, 0xEEF8, 0x0000, 0xB551, 0xB551, 0x0000, 0xEEF8, 0xEEF8,
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 0xEEF8, 0xEEF8, 0xEEF8, 0xEEF8, 0xEEF8, 0xEEF8, 0xEEF8, 0xEEF8, 0xEEF8, 0xEEF8, 0xEEF8, 0xEEF8, 0xEEF8, 0xEEF8, 0xEEF8, 0xEEF8,


};




const unsigned short raikou[] = {
 0xEEF8, 0xEEF8, 0xEEF8, 0xEEF8, 0xEEF8, 0xEEF8, 0xEEF8, 0xEEF8, 0xEEF8, 0xEEF8, 0xEEF8, 0xEEF8, 0xEEF8, 0xEEF8, 0xEEF8, 0xEEF8,
 0xEEF8, 0xEEF8, 0x0000, 0xEEF8, 0x059B, 0xEEF8, 0x0000, 0xEEF8, 0xEEF8, 0x0000, 0xEEF8, 0x059B, 0xEEF8, 0x0000, 0xEEF8, 0xEEF8,
 0xEEF8, 0xEEF8, 0x0354, 0x0354, 0x0354, 0x059B, 0x0354, 0xEEF8, 0xEEF8, 0x0354, 0x059B, 0x0354, 0x0354, 0x0354, 0xEEF8, 0xEEF8,
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 0xEEF8, 0xEEF8, 0xEEF8, 0xEEF8, 0xEEF8, 0xEEF8, 0xEEF8, 0xEEF8, 0xEEF8, 0xEEF8, 0xEEF8, 0xEEF8, 0xEEF8, 0xEEF8, 0xEEF8, 0xEEF8,


};


const unsigned short suicune[] = {
 0xEEF8, 0xEEF8, 0xEEF8, 0xEEF8, 0xEEF8, 0xEEF8, 0xEEF8, 0xEEF8, 0xEEF8, 0xEEF8, 0xEEF8, 0xEEF8, 0xEEF8, 0xEEF8, 0xEEF8, 0xEEF8,
 0xEEF8, 0xEEF8, 0xEEF8, 0xEEF8, 0xEEF8, 0xEEF8, 0x0000, 0x0000, 0xEEF8, 0xEEF8, 0xEEF8, 0xEEF8, 0xEEF8, 0xEEF8, 0x0000, 0x0000,
 0xEEF8, 0xEEF8, 0xEEF8, 0xEEF8, 0xEEF8, 0xEEF8, 0xEEF8, 0x0000, 0xFCD0, 0xFCD0, 0x0000, 0xEEF8, 0xEEF8, 0xEEF8, 0xEEF8, 0x0000,
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 0xEEF8, 0xEEF8, 0xEEF8, 0xEEF8,

};

extern uint32_t Index;
extern uint32_t counter;
uint32_t TestLuck(void){
	//inputs: none
	//output: 8bit number, top 4 bits are for special att buff, bottom 4 bits are for att buff

	uint8_t buff;
	uint8_t gamble;
	uint32_t Data;
	uint8_t atk;
	uint8_t spa;
	uint8_t result;
	//uint32_t delaycount = 1; //should be 50 for board (wait 5 s)
	//uint32_t time;
	char winbuff[]={'C', 'o', 'n', 'g', 'r', 'a', 't', 's', '!', 0x00};
	char sorry[]={'T', 'o', 'o', ' ', 'b', 'a', 'd', '!', 0x00};
	char notice1[] = {'C', 'h', 'a', 'n', 'c', 'e', '!', 0x00};
	char notice2[] = {'W', 'i', 'n', ' ', 'a', ' ', 'b', 'o', 'o', 's', 't', '!', 0x00};
	//uint32_t count;
	uint16_t gold = ST7735_Color565(255, 204, 51); //feel free to change bg of roulette
	uint16_t black = ST7735_Color565(0, 0, 0);
	uint32_t random;
	
	ST7735_DrawString(9, 5, notice1, black);
	ST7735_DrawString(7, 6, notice2, black);
		
	//ADC_Init();
	//Random_Init(NVIC_ST_CURRENT_R);
	ST7735_FillRect(0, 98, 160, 29, gold); //after rotation, it will be (0, 160, 160, 29, gold)
	ST7735_DrawFastVLine(53, 98, 28, black); //after rotation, it will be ST7735_DrawFastHLine(53, 100, 28, black);
	ST7735_DrawFastVLine(106, 98, 28, black); //after rotation, it will be ST7735_DrawFastHLine(106, 100, 28, black);
	/*
	ST7735_DrawFastHLine(23, 112, 4, black);	//first question mark, ST7735_DrawFastHLine(23, 112, 4, black);
	ST7735_DrawFastVLine(27, 112, 4, black);	//ST7735_DrawFastVLine(27, 112, 4, black);
	ST7735_DrawFastHLine(24, 112, 4, black);  //ST7735_DrawFastHLine(24, 112, 4, black);
	ST7735_DrawFastVLine(24, 112, 2, black);	//ST7735_DrawFastVLine(24, 112, 2, black);
	ST7735_DrawPixel(24, 115, black);         //ST7735_DrawPixel(24, 115, black);
	
	ST7735_DrawFastHLine(78, 112, 4, black);	//second question mark, ST7735_DrawFastHLine(78, 112, 4, black);
	ST7735_DrawFastVLine(82, 112, 4, black);	//ST7735_DrawFastHLine(82, 112, 4, black);
	ST7735_DrawFastHLine(79, 112, 4, black);  //ST7735_DrawFastHLine(79, 112, 4, black);
	ST7735_DrawFastVLine(79, 112, 2, black);	//ST7735_DrawFastVLine(79, 112, 2, black);
	ST7735_DrawPixel(79, 115, black);		      //ST7735_DrawPixel(79, 115, black);
	
	ST7735_DrawFastHLine(131, 112, 4, black);	//third question mark, ST7735_DrawFastHLine(131, 112, 4, black);
	ST7735_DrawFastHLine(135, 112, 4, black);	//ST7735_DrawFastHLine(135, 112, 4, black);
	ST7735_DrawFastHLine(132, 112, 4, black); //ST7735_DrawFastHLine(132, 112, 4, black);
	ST7735_DrawFastVLine(132, 112, 2, black);	//ST7735_DrawFastVLine(132, 112, 2, black);
	ST7735_DrawPixel(132, 115, black);	 	    //ST7735_DrawPixel(132, 115, black);
	*/
	//ST7735_DrawFastVLine(53, 100, 28, black);// the arrow, ST7735_DrawFastVLine(53, 100, 28, black);
	
	while((GPIO_PORTE_DATA_R&0x3B)==0){
			Data = ADC_In();
			if(Data<=0x0555){ //first section
				gamble=0;
				ST7735_FillRect(71, 79, 19, 19, 0xEEF8);//clears second option, ST7735_FillRect(78, 150, 5, 10, 0xEEF8);
				ST7735_FillRect(127, 79, 19, 19, 0xEEF8);//clears third option, ST7735_FillRect(131, 150, 5, 10, 0xEEF8);
				ST7735_DrawBitmap(18, 97, entei, 16, 18);
			}
			if(Data>0x0555 && Data<=0x0AAA){ //second section
				gamble=1;
				ST7735_FillRect(18, 79, 19, 19, 0xEEF8);//clears first option, after rotation shown above
				//ST7735_FillRect(71, 79, 19, 19, 0xEEF8);//clears second option
				ST7735_FillRect(127, 79, 19, 19, 0xEEF8);//clears third option
				ST7735_DrawBitmap(73, 97, suicune, 18, 18);
			}
			if(Data>0x0AAA && Data<=4095){ //third section
				gamble=2;
				ST7735_FillRect(18, 79, 19, 19, 0xEEF8);//clears first option, after rotation shown above
				ST7735_FillRect(71, 79, 19, 19, 0xEEF8);//clears second option
				//ST7735_FillRect(127, 19, 19, 19, 0xEEF8);//clears third option
				ST7735_DrawBitmap(127, 97, raikou, 16, 17);
			}
  }
	/*
	Sound_Stop();
	Sound_Init(7256);
	Sound_Select();
	while(Index != (counter-1));
	Sound_Init(14512);
	Sound_Battle1();
	Sound_Resume();
	*/
	random=Random(); //random=Random();
	ST7735_FillRect(0, 98, 128, 29, gold); //after rotation, it will be (0, 160, 160, 29, gold)
	ST7735_DrawFastVLine(53, 99, 28, black); //after rotation, it will be ST7735_DrawFastHLine(53, 100, 28, black);
	ST7735_DrawFastVLine(106, 99, 28, black); //after rotation, it will be ST7735_DrawFastHLine(106, 100, 28, black);
	
	if(random<=0x55){
		//count = ST7735_DrawString(1, 14, &attack2[0], black);//14 should be 19ish
		ST7735_FillRect(0, 98, 52, 29, 0x079F);//0x079F = bright yellow
		buff = 0; 
	}
	else if((random>0x55) && (random<=0xAA)){
		//count = ST7735_DrawString(8, 14, &attack3[0], black);// 8 should be 5ish, 14 should be 19ish
		ST7735_FillRect(54, 98, 52, 29, 0x079F);
		buff = 1; 
	}
	else if((random>0xAA) && (random<=0xFF)){
		//count = ST7735_DrawString(16, 14, &attack1[0], black);//16 should be 10ish, 14 should be 19ish
		ST7735_FillRect(107, 98, 52, 29, 0x079F);
		buff = 2;
	}
	
	ST7735_FillRect(0, 28, 160, 50, 0xEEF8);
	
	uint8_t randBuff = Random()%3;
	
	if(gamble != buff){
		atk = 0;
		spa = 0;
		result = 0x00;
		char atkmessage[]={'A', 'T', 'K', ' ', ' ', '+', (atk+0x30), 0x00};
		char spamessage[]={'S', 'P', 'A', ' ', ' ', '+', (spa+0x30), 0x00};
		ST7735_DrawString(10, 4, sorry, 0x0000);
		ST7735_DrawString(10, 5, atkmessage, 0x0000);
		ST7735_DrawString(10, 6, spamessage, 0x0000);
	}
	else if(gamble == buff){
		Sound_Stop();
		Sound_Obtain();
		if(randBuff == 0){		//physical attack + 1, projectile attack + 1
			atk = 1;
			spa = 1;
			result = 0x11;
		}
		else if(randBuff == 1){	//physical attack + 2
			atk = 2;
			spa = 0;
			result = 0x02;
		}
		else if(randBuff == 2){	 //projectile attack + 3
			atk = 0;
			spa = 3;
			result = 0x30;
		}
		char atkmessage[]={'A', 'T', 'K', ' ', ' ', '+', (atk+0x30), 0x00};
		char spamessage[]={'S', 'P', 'A', ' ', ' ', '+', (spa+0x30), 0x00};
		ST7735_DrawString(9, 4, winbuff, 0x0000);
		ST7735_DrawString(9, 5, atkmessage, 0x0000);
		ST7735_DrawString(9, 6, spamessage, 0x0000);
		while(Index != (counter - 1));
		Sound_Battle1();
		Sound_Resume();
	}
	while((GPIO_PORTE_DATA_R&0x3B) == 0x00);
	return result;
}
